## Kconfig
```kconfig
config ZMK_USB_BOOTMAGIC
    bool "Reboot into the bootloader when USB is connected while a key is held"
    default y
    depends on DT_HAS_ZMK_USB_BOOTMAGIC_ENABLED && USB_DEVICE_STACK

# 充電中の LED 表示 (src/charge_indicator.c。4mplelab/zmk-feature-charge-indicator から取り込んだもの)
menu "Charge Indicator"

config CHARGE_INDICATOR
    bool "Enable charge status LED indicator"
    default n

config CHG_POLICY
    bool "Force off during charging (suppress widget)"
    default n
    help
      y: While charging, force LEDs OFF and suppress widget output.
      n: While charging, show selected color (CHG_COLOR) and suppress widget output.

config CHG_COLOR
    int "Charging color value (0-7)"
    range 0 7
    default 1
    help
      0 Black, 1 Red, 2 Green, 3 Yellow, 4 Blue, 5 Magenta, 6 Cyan, 7 White

config CHG_BATTERY_LEVEL_BASED_COLOR
    bool "Use battery level based color instead of fixed color"
    default y
    help
      y: LED color changes based on battery level while charging.
      n: Use fixed color (CONFIG_CHG_COLOR) while charging.

if CHG_BATTERY_LEVEL_BASED_COLOR

config CHG_BATTERY_LEVEL_HIGH
    int "High battery level percentage"
    default 80

config CHG_BATTERY_LEVEL_LOW
    int "Low battery level percentage"
    default 20

config CHG_BATTERY_LEVEL_CRITICAL
    int "Critical battery level percentage"
    default 5

config CHG_BATTERY_COLOR_HIGH
    int "Color for high battery level (above LEVEL_HIGH)"
    range 0 7
    default 2
    help
      0 Black, 1 Red, 2 Green, 3 Yellow, 4 Blue, 5 Magenta, 6 Cyan, 7 White

config CHG_BATTERY_COLOR_MEDIUM
    int "Color for medium battery level (between LEVEL_LOW and LEVEL_HIGH)"
    range 0 7
    default 3
    help
      0 Black, 1 Red, 2 Green, 3 Yellow, 4 Blue, 5 Magenta, 6 Cyan, 7 White

config CHG_BATTERY_COLOR_LOW
    int "Color for low battery level (below LEVEL_LOW)"
    range 0 7
    default 1
    help
      0 Black, 1 Red, 2 Green, 3 Yellow, 4 Blue, 5 Magenta, 6 Cyan, 7 White

config CHG_BATTERY_COLOR_CRITICAL
    int "Color for critical battery level (below LEVEL_CRITICAL)"
    range 0 7
    default 5
    help
      0 Black, 1 Red, 2 Green, 3 Yellow, 4 Blue, 5 Magenta, 6 Cyan, 7 White

config CHG_BATTERY_COLOR_MISSING
    int "Color for battery not detected"
    range 0 7
    default 0
    help
      0 Black, 1 Red, 2 Green, 3 Yellow, 4 Blue, 5 Magenta, 6 Cyan, 7 White

endif

endmenu
```

## config/west.yml
```yaml
manifest:
  remotes:
    - name: zmkfirmware
      url-base: https://github.com/zmkfirmware
    - name: sekigon-gonnoc
      url-base: https://github.com/sekigon-gonnoc
    - name: caksoylar
      url-base: https://github.com/caksoylar
    - name: 4mplelab
      url-base: https://github.com/4mplelab
    - name: ryo-aoki-pc
      url-base: https://github.com/ryo-aoki-pc
  projects:
    - name: zmk
      remote: zmkfirmware
      revision: v0.3.0
      import: app/west.yml
    - name: zmk-driver-paw3222
      remote: sekigon-gonnoc
      revision: main
    - name: zmk-rgbled-widget
      remote: caksoylar
      revision: v0.3
    - name: zmk-feature-charge-indicator
      remote: 4mplelab
      revision: main
    # トラックボールの速さに応じてカーソルに倍率を掛ける入力プロセッサ (lism.dtsi の trackball_accel)
    - name: zmk-input-processor-xy-accel
      remote: ryo-aoki-pc
      revision: a5233f76a88b369dfebc37371f8244c89df2d0d4
    # キー入力の振動などでボールがわずかに動いても AML を発動させない入力プロセッサ (lism.dtsi の aml_threshold)
    - name: zmk-input-processor-aml-threshold
      remote: ryo-aoki-pc
      revision: 98f317118e81c6fe9df5e88fc5acc554ecbc9af1
  self:
    path: config
```

## dts/bindings/zmk,usb-bootmagic.yaml
```yaml
description: |
  このキーを押したまま USB ケーブルを挿すと、その半分をブートローダ (UF2) で再起動する
  (QMK の Bootmagic と同じ使い方)。キーの押下と USB 給電の検出をその半分の中で判定するので、
  分割キーボードのペリフェラルでも、セントラルの電源や接続が無くても使える。
  左右それぞれの overlay に 1 つずつ置く (1 つのファームウェアに 1 つだけ)。

compatible: "zmk,usb-bootmagic"

properties:
  row:
    type: int
    required: true
    description: その半分の kscan 上の行 (matrix transform の RC(row, column) の row から row-offset を引いた値)
  column:
    type: int
    required: true
    description: その半分の kscan 上の列 (matrix transform の RC(row, column) の column から col-offset を引いた値)
```
