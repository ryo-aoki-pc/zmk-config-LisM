#include "../non_trackball.overlay"

// split経由のリスナーを有効化
// （反対側半身にトラックボールがある場合に対応。
//   XY反転はペリフェラル側 trackball_split で適用済み）
&peripheral_listener {
    status = "okay";
    input-processors =
        <&trackball_accel>,         // 速さに応じた倍率（カーソルの加速）
        <&aml_threshold 8 10000>;   // 8 = MOUS（マウス移動レイヤーを自動有効化。わずかな動きでは発動しない）

    scroller {
        layers = <9>;               // 9 = SCRL（スクロールレイヤー）
        input-processors =
            <&zip_temp_layer 8 10000>,                     // 8 = MOUS（スクロール中も MOUS を維持する）
            <&zip_xy_transform INPUT_TRANSFORM_Y_INVERT>,  // 左TBスクロールの上下反転を解消（trackball-central と同じ）
            <&zip_xy_to_scroll_mapper>,
            <&zip_scroll_scaler 1 16>;
    };
};
